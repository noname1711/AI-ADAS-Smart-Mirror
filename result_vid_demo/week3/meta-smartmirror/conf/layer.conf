## result_vid_demo/week3/meta-smartmirror/conf/layer.conf
```bitbake
BBPATH .= ":${LAYERDIR}"

BBFILES += "${LAYERDIR}/recipes-*/*/*.bb \
            ${LAYERDIR}/recipes-*/*/*.bbappend"

BBFILE_COLLECTIONS += "smartmirror"
BBFILE_PATTERN_smartmirror = "^${LAYERDIR}/"
BBFILE_PRIORITY_smartmirror = "6"

LAYERSERIES_COMPAT_smartmirror = "scarthgap"

LAYERDEPENDS_smartmirror = "core openembedded-layer"

BBLAYERS_LAYERINDEX_NAME_smartmirror = "meta-smartmirror"

DISTRO_FEATURES:append = " systemd"
DISTRO_FEATURES:remove = " sysvinit"

VIRTUAL-RUNTIME_init_manager = "systemd"
VIRTUAL-RUNTIME_initscripts = ""
```
